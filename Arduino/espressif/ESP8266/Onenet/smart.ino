#include <Wire.h>
#include <Servo.h>
#include <SimpleDHT.h>
#include <NTPClient.h>
#include <WiFiUdp.h>
#include <ACROBOTIC_SSD1306.h>
#include <ArduinoJson.h>
#include <ESP8266WiFi.h>
#include <PubSubClient.h>

unsigned char ACROBOT[]={
    0x00, 0x00, 0x00, 0x00, 0x00, 0x00, 0x00, 0x00, 0x00, 0x00, 0x00, 0x00, 0x00, 0x00, 0x00, 0x00, 
    0x00, 0x00, 0x00, 0x00, 0x00, 0x00, 0x00, 0x00, 0x00, 0x00, 0x00, 0x00, 0x00, 0x00, 0x00, 0x00, 
    0x00, 0x00, 0x00, 0x00, 0x00, 0x00, 0x00, 0x00, 0x00, 0x00, 0x00, 0x00, 0x00, 0x00, 0x00, 0x00, 
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    0x00, 0x00, 0x00, 0x00, 0x00, 0x00, 0x00, 0x00, 0x00, 0x00, 0x00, 0x00, 0x00, 0x00, 0x00, 0x00
};

const char* ssid = "M";                
const char* password = "******";
const char* mqtt_server = "183.230.40.39";
Servo myservo;
int pinDHT11 = 2;
SimpleDHT11 dht11(pinDHT11);
WiFiClient espClient;
PubSubClient client(espClient);
WiFiUDP ntpUDP;
NTPClient timeClient(ntpUDP, "europe.pool.ntp.org", 3600, 60000);
long lastMsg = 0;
void setup_wifi() {

  delay(10);
  // We start by connecting to a WiFi network
  Serial.println();
  Serial.print("Connecting to ");
  Serial.println(ssid);
  WiFi.begin(ssid, password);
  while (WiFi.status() != WL_CONNECTED) {
    delay(500);
    Serial.print(".");
  }

  Serial.println("");
  Serial.println("WiFi connected");
  Serial.println("IP address: ");
  Serial.println(WiFi.localIP());
}
void request(short state){
  char tmp[18];
  snprintf_P(tmp,sizeof(tmp),PSTR("{\"LED\":\"%d\"}"),state);
  uint16_t streamLen= strlen(tmp);
  char d[3];
  d[0]='\x03';
  d[1] = (streamLen >> 8);
  d[2] = (streamLen & 0xFF);
  char msg[21];
  snprintf_P(msg,sizeof(msg),PSTR("%c%c%c%s"),d[0],d[1],d[2], tmp);
  client.publish("$dp", (uint8_t*)msg,streamLen+3,false);
}
void temp_upload(int temperature){
  char tmp[32];
  snprintf_P(tmp,sizeof(tmp),PSTR("{\"temperature\":\"%d\"}"),temperature);
  uint16_t streamLen= strlen(tmp);
  char d[3];
  d[0]='\x03';
  d[1] = (streamLen >> 8);
  d[2] = (streamLen & 0xFF);
  char msg[27];
  snprintf_P(msg,sizeof(msg),PSTR("%c%c%c%s"),d[0],d[1],d[2], tmp);
  client.publish("$dp", (uint8_t*)msg,streamLen+3,false);
}
void humi_upload(int humidity){
  char tmp[32];
  snprintf_P(tmp,sizeof(tmp),PSTR("{\"humidty\":\"%d\"}"),humidity);
  uint16_t streamLen= strlen(tmp);
  char d[3];
  d[0]='\x03';
  d[1] = (streamLen >> 8);
  d[2] = (streamLen & 0xFF);
  char msg[27];
  snprintf_P(msg,sizeof(msg),PSTR("%c%c%c%s"),d[0],d[1],d[2], tmp);
  client.publish("$dp", (uint8_t*)msg,streamLen+3,false);
}
void callback(char* topic, byte* payload, unsigned int length) {
  String message="";
  DynamicJsonDocument doc;
  Serial.print("Message arrived [");
  Serial.print(topic);
  Serial.print("]");
  for (int i = 0; i < length; i++) {
    Serial.print((char)payload[i]);
    message+=(char)payload[i];
  }
  Serial.println(" ");
  if((String)topic=="cmd_LED")
  {
    if(!message.compareTo("ON")){
      digitalWrite(16, HIGH);
      Serial.println("TURN ON THE LED");
    }
   else{
    digitalWrite(16, LOW);
    Serial.println("TURN OFF THE LED");
  }
     return;
  }
  else
  {
    Serial.println("Thank you.");
  }
  if((String)topic=="LED_brightness_set")
  {
     Serial.println("LIGHT RECEIVED");
     return;
  }
  else{
    Serial.println("Thank you.");
  }
  deserializeJson(doc, message);
  JsonObject obj = doc.as<JsonObject>();

  if(obj["message"]["id"]=="LED"){
    if (obj["message"]["status"]=="ON"){
       Serial.println("Let's turn on the LED.");
       digitalWrite(16, HIGH); 
       oled.setTextXY(7,12);      
       oled.putString("ON ");
       request(1);
    } else if(obj["message"]["status"]=="OFF"){
      Serial.println("Let's turn off the LED.");
      digitalWrite(16, LOW); 
      oled.setTextXY(7,12);      
      oled.putString("OFF");
      request(0);
      temp_upload(24);
    }else if(obj["message"]["status"]=="blink"){
      Serial.println("Show yourself.");
      for(int i = 0;i<100;i++){
        digitalWrite(16, !digitalRead(16));
        delay(100);
      }
    }
    else{
      Serial.println("data error!");
    }
  }
  if(obj["message"]["id"]=="slider"){
    if(obj["message"]["grade"]=="ON")
    {
      oled.setTextXY(3,12);      
      oled.putString("ON ");
      myservo.write(0);
      delay(10);
    }
    else if(obj["message"]["grade"]=="OFF"){
      oled.setTextXY(3,12);      
      oled.putString("OFF");
      myservo.write(180);
      delay(10);
    }
    else{
      char server[8]="null";
      sprintf(server,"%d  ",(int)obj["message"]["grade"]);
      oled.setTextXY(3,12);      
      oled.putString(server);
      
      int pos=0;
      pos=((int)obj["message"]["grade"]+10)*9;
      myservo.write(pos);
      delay(10);
    }
  }
}

void reconnect() {
  // Loop until we're reconnected
  while (!client.connected()) {
    Serial.print("Attempting MQTT connection...");
    // Attempt to connect
    if (client.connect("505695046","179383","******************")) {
      Serial.println("connected");
      client.subscribe("iPhone");
      client.subscribe("raspberrypi");
    } else {
      Serial.print("failed, rc=");
      Serial.print(client.state());
      Serial.println(" try again in 5 seconds");
      // Wait 5 seconds before retrying
      delay(5000);
    }
  }
}
unsigned int cnt=1800;
void setup() {
  pinMode(2, OUTPUT);
  digitalWrite(2, HIGH);
  pinMode(16, OUTPUT);    
  digitalWrite(16, LOW); 
  myservo.attach(15 );
  Wire.begin();  
  oled.init();                      // Initialze SSD1306 OLED display
  oled.clearDisplay();              // Clear screen
  oled.drawBitmap(ACROBOT, 1024);   // 1024 pixels for logo
  oled.setTextXY(0,1);              // Set cursor position
  oled.putString("Welcome to Home");
  oled.setTextXY(1,0);      
  oled.putString("Temp:");
  oled.setTextXY(3,0);      
  oled.putString("Humi:");
  oled.setTextXY(2,10);      
  oled.putString("SERVER");
  oled.setTextXY(3,12);      
  oled.putString("0");
  oled.setTextXY(6,12);      
  oled.putString("LED:");
  oled.setTextXY(7,12);      
  oled.putString("OFF");
  
  Serial.begin(115200);
  setup_wifi();
  client.setServer(mqtt_server, 6002);
  client.connect("505695046","179383","*************************");
  client.setCallback(callback);
  client.subscribe("iPhone");
  client.subscribe("raspberrypi");
  client.setCallback(callback);
  
  Serial.println("Welcome to HPU.");
}
void loop() {
  if (!client.connected()) {
    digitalWrite(2, LOW);
    reconnect();
    
  }
  else{
    digitalWrite(2, HIGH);
  }
  client.loop();

  long now = millis();
  if (now - lastMsg > 1000) {
    cnt++;
    if(cnt>=1800){
      cnt=0;

      byte temperature = 0;
      byte humidity = 0;
      int err = SimpleDHTErrSuccess;
      if ((err = dht11.read(&temperature, &humidity, NULL)) != SimpleDHTErrSuccess) {
      cnt=1799;
      oled.setTextXY(2,0);      
      oled.putString("****");
      oled.setTextXY(4,0);      
      oled.putString("****");
      Serial.print("Read DHT11 failed, err="); Serial.println(err);delay(500);
      return;
    }
    
      char buff[16]="null";
      sprintf(buff,"%d*C ",(int)temperature);
      oled.setTextXY(2,0);      
      oled.putString(buff);
      sprintf(buff,"%dH ",(int)humidity);
      oled.setTextXY(4,0);      
      oled.putString(buff);
      temp_upload((int)temperature);
      humi_upload((int)humidity);
      Serial.println("Uplode successfully.");
    }
    lastMsg = now;
    timeClient.update();
    oled.setTextXY(1,8); 
    oled.putString(timeClient.getFormattedTime()); 
  }
}







